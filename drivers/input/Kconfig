## drivers/input/Kconfig
```kconfig
menuconfig INPUT_AZOTEQ_IQS5XX
    bool "Azoteq IQS5xx trackpads"
    default y
    depends on GPIO
    depends on I2C
    depends on INPUT
    depends on DT_HAS_AZOTEQ_IQS5XX_ENABLED
    help
      Enable driver for Azoteq IQS5xx trackpads.

if INPUT_AZOTEQ_IQS5XX

config INPUT_AZOTEQ_IQS5XX_INIT_PRIORITY
    int "Azoteq IQS5xx initialization priority"
    default INPUT_INIT_PRIORITY
    help
      Driver initialization priority for the IQS5xx driver.
      Lower values initialize earlier.

config INPUT_AZOTEQ_IQS5XX_GESTURE_DEBUG
    bool "Log raw gesture/finger data (debug)"
    help
      Emit a LOG_INF line on every multi-finger cycle with the raw gesture
      event bytes, finger count, and both contacts' absolute coordinates.
      For diagnosing gesture detection (e.g. zoom). Requires the input log
      level at INF and a log backend (e.g. CONFIG_ZMK_USB_LOGGING). Noisy;
      do not ship enabled.

endif # INPUT_AZOTEQ_IQS5XX
```

## dts/bindings/input/azoteq,iqs5xx-common.yaml
```yaml
properties:
  rdy-gpios:
    type: phandle-array
    description: "Data Ready pin for the Azoteq IQS5xx trackpad"
  
  reset-gpios:
    type: phandle-array
    description: "Reset pin for the Azoteq IQS5xx trackpad"

  one-finger-tap:
    type: boolean
    description: "Register single finger tap gestures and report them as a left click"

  press-and-hold:
    type: boolean
    description: "Register press and hold gestures and report them as a left click until released"
  
  press-and-hold-time:
    type: int
    description: "Time in ms (in addition to the tap time) it takes to register a press and hold gesture"
    default: 250

  two-finger-tap:
    type: boolean
    description: "Register two finger tap gestures and report them as a right click"

  three-finger-tap:
    type: boolean
    description: |
      Report a quick three-finger tap as a middle click. Synthesized in the
      driver from the finger-count register (the chip has no native 3-finger
      gesture); requires the chip's touch events, which the driver enables.

  drag-lock:
    type: boolean
    description: |
      When set, a press-and-hold latches a persistent drag-LOCK: the left button
      stays held across finger lifts (so a drag can span multiple strokes) and is
      released by a tap. When unset, press-and-hold is momentary -- the button is
      held only while the finger stays down and releases on lift.

  tap-then-hold:
    type: boolean
    description: |
      Engage drag-lock from a tap-then-touch sequence: a single-finger tap
      followed by another single-finger touch-down within ~250ms latches the
      left button (persistent drag-lock, released by a tap). Use this instead
      of the chip's press-and-hold so a drag starts the moment the second
      touch lands, with no hold-time wait. Requires drag-lock. Multi-finger
      activity (scroll/multi-tap) within the window cancels engagement.

  scroll:
    type: boolean
    description: "Register and report scroll gestures, both vertical and horizontal scroll is supported"

  natural-scroll-x:
    type: boolean
    description: "Whether content should track finger movement when scrolling on the x axis."

  natural-scroll-y:
    type: boolean
    description: "Whether content should track finger movement when scrolling on the y axis."

  switch-xy:
    type: boolean
    description: "Flip x and y axes"
  
  flip-x:
    type: boolean
    description: "Invert the direction of the x axis"

  flip-y:
    type: boolean
    description: "Invert the direction of the y axis"

  bottom-beta:
    type: int
    description: |
      Amount of filtering applied at slow speeds.
      0: Most filtering, smoother, but laggier.
      255: Least filtering, least smooth, more responsive.
    default: 5
  
  stationary-threshold:
    type: int
    description: |
      How far a finger must move (in pixels) to not be considered stationary.
    default: 5

  cursor-scale-percent:
    type: int
    description: |
      Scale applied to the cursor's reported REL_X / REL_Y deltas, as a
      percentage of the chip's raw value. Default 100 = no scaling. Set lower to
      slow the cursor in firmware (e.g. 50 = half-speed), so the feel is
      consistent across host machines without OS pointer tweaks. The scroll
      divisor is slowed at HALF this percentage's strength (scroll_scale =
      (100 + cursor-scale-percent) / 2) so the wheel doesn't feel as heavy
      as the cursor. A per-axis fractional accumulator preserves sub-unit
      motion so slow precision movement isn't lost to integer truncation.
    default: 100
```
